## src/modules/transform_control/Kconfig
```kconfig
menuconfig MODULES_TRANSFORM_CONTROL
    bool "transform_control"
    default n
    ---help---
        Enable dynamic transform control module for the quadrotor.
```
